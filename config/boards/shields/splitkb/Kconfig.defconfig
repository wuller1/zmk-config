## config/boards/shields/splitkb/Kconfig.defconfig
```kconfig
if SHIELD_SPLITKB_LEFT

config ZMK_KEYBOARD_NAME
    default "splitkb"

config ZMK_SPLIT_ROLE_CENTRAL
    default y

endif

if SHIELD_SPLITKB_LEFT || SHIELD_SPLITKB_RIGHT

config ZMK_SPLIT
    default y

if ZMK_DISPLAY

config I2C
    default y

config SSD1306
    default y

config SSD1306_REVERSE_MODE
    bool "Enable reverse mode for SSD1306"
    default y

endif # ZMK_DISPLAY

if LVGL

config LVGL_VDB_SIZE
    int "VDB Size for LVGL"
    default 64
    range 32 256  # Specify a valid range for the size

config LVGL_DPI
    int "DPI for LVGL"
    default 148
    range 96 300  # Specify a valid range for DPI

config LVGL_BITS_PER_PIXEL
    int "Color bits per pixel"
    default 1
    range 1 32  # Specify a valid range for bits per pixel

choice LVGL_COLOR_DEPTH
    prompt "Color Depth"
    default LVGL_COLOR_DEPTH_1
    config LVGL_COLOR_DEPTH_1
        bool "1 bit"
    config LVGL_COLOR_DEPTH_2
        bool "2 bits"
    config LVGL_COLOR_DEPTH_4
        bool "4 bits"
    config LVGL_COLOR_DEPTH_8
        bool "8 bits"
endchoice

endif # LVGL

endif
```
